## buildroot/glassglide_defconfig
```kconfig
BR2_arm=y
BR2_cortex_a9=y
BR2_ARM_ENABLE_NEON=y
BR2_ARM_ENABLE_VFP=y
BR2_ARM_ENABLE_FP16=y
BR2_ARM_EABI=y
BR2_ARM_FPU_NEON_FP16=y
BR2_ARM_INSTRUCTIONS_ARM=y
BR2_TOOLCHAIN_EXTERNAL=y
BR2_TOOLCHAIN_EXTERNAL_CUSTOM=y
BR2_TOOLCHAIN_EXTERNAL_PREINSTALLED=y
BR2_TOOLCHAIN_EXTERNAL_CUSTOM_PREFIX="arm-webos-linux-gnueabi"
BR2_TOOLCHAIN_EXTERNAL_GCC_16=y
BR2_TOOLCHAIN_EXTERNAL_HEADERS_3_10=y
BR2_TOOLCHAIN_EXTERNAL_CUSTOM_GLIBC=y
BR2_TOOLCHAIN_EXTERNAL_CXX=y
BR2_JLEVEL=1
BR2_OPTIMIZE_S=y
BR2_PACKAGE_LGTV=y
BR2_PACKAGE_WEBOS=y
BR2_PACKAGE_WEBOS_USERLAND=y
BR2_PACKAGE_LIBXKBCOMMON=y
BR2_PACKAGE_WPEWEBKIT=y
# BR2_PACKAGE_WPEWEBKIT_SANDBOX is not set
# BR2_PACKAGE_WPEWEBKIT_MULTIMEDIA is not set
```
